/dts-v1/;
/plugin/;

/ {
    compatible = "brcm,bcm2708";

    fragment@0 {
        target = <&gpio>;
        __overlay__ {
	  pinctrl-names = "default";
	  pinctrl-0 = <&dcdc-on_pins>;

	  dcdc-on_pins: dcdc-on_pins {
				brcm,pins = <23>; // gpio number
				brcm,function = <1>; // 0 = input, 1 = output
				brcm,pull = <0>; // 0 = none, 1 = pull down, 2 = pull up

		};
            my_led: myled {
                label = "MYLED";
                gpios = <&gpio 18 0>;
                linux,default-trigger = "heartbeat";
            };
        };
    };
  fragment@1 {
	target =
  }
};
